## hc_sr04/dts/bindings/elecfreaks,hc-sr04.yaml
```yaml
# Copyright (c) 2020 Daniel Veilleux
# SPDX-License-Identifier: LicenseRef-BSD-5-Clause-Nordic

description: HC-SR04 Ultrasonic Ranging Module

compatible: "elecfreaks,hc-sr04"

include: base.yaml

properties:
  label:
    type: string
    description: Human readable string describing the device (used as device_get_binding() argument)

  status:
    type: string
    description: Human readable string describing the device's status

  trig-gpios:
    type: phandle-array
    description: Trigger pin

  echo-gpios:
    type: phandle-array
    description: Echo pin
```
