## CMakeLists.txt
```
cmake_minimum_required(VERSION 3.20.0)
find_package(Zephyr REQUIRED HINTS $ENV{ZEPHYR_BASE})
project(hc-sr04)

FILE(GLOB app_sources src/*.c)
target_sources(app PRIVATE ${app_sources})
```

## prj.conf
```kconfig
CONFIG_GPIO=y
CONFIG_SENSOR=y
CONFIG_LOG=y
CONFIG_LOG_PRINTK=y
CONFIG_HC_SR04=y
```

## esp32_devkitc_wroom.overlay
```dts
/ {
	hc_sr04: hc_sr04 {
		compatible = "hc-sr04";
		trigger-gpios = <&gpio0 15 GPIO_ACTIVE_HIGH>;
		echo-gpios = <&gpio0 2 GPIO_ACTIVE_HIGH>;
		status = "okay";
	};
};
```

## esp32s2_saola.overlay
```dts
/ {
	hc_sr04: hc_sr04 {
		compatible = "hc-sr04";
		trigger-gpios = <&gpio0 12 GPIO_ACTIVE_HIGH>;
		echo-gpios = <&gpio0 11 GPIO_ACTIVE_HIGH>;
		status = "okay";
	};
};
```

## wio_lite_riscv.overlay
```dts
/*
 * Copyright (c) 2022 Hiroki Tada
 * SPDX-License-Identifier: Apache-2.0
 */

/ {
	hc_sr04: hc_sr04 {
		compatible = "hc-sr04";
		trig-gpios = <&gpioa 0 GPIO_ACTIVE_HIGH>;
		echo-gpios = <&gpioa 1 GPIO_ACTIVE_HIGH>;	
	};
};
```

## boards/wio_lite_riscv.overlay
```dts
/*
 * Copyright (c) 2022 Hiroki Tada
 * SPDX-License-Identifier: Apache-2.0
 */

/ {
	sensors {
		us0: hc-sr04 {
			compatible = "elecfreaks,hc-sr04";
			label = "HC-SR04_0";
			trig-gpios = <&gpioa 0 GPIO_ACTIVE_HIGH>;
			echo-gpios = <&gpioa 1 GPIO_ACTIVE_HIGH>;
			status = "okay";	
		};
	};
};
```

## src/main.c
```c
/*
 * Copyright (c) 2020 Daniel Veilleux
 *
 * SPDX-License-Identifier: Apache-2.0
 */

#include <zephyr/kernel.h>
#include <string.h>
#include <stdio.h>
#include <zephyr/devicetree.h>
#include <zephyr/drivers/gpio.h>
#include <zephyr/drivers/sensor.h>
#include <zephyr/logging/log.h>

//#define HC_SR04 DT_NODELABEL(hc_sr04)

struct sensors_data {
	uint16_t distance1;
	uint16_t distance2;
};

static const struct device *get_hc_sr04_device(void){
	const struct device *dev = DEVICE_DT_GET_ANY(hc_sr04);
	if (dev == NULL){
		printk("\nError: no device \n");
                return NULL;
	}

	if (!device_is_ready(dev)){
                printk("\n Error Device \"%s\" is not ready;"
                        "check the driver initialization logs for errors.\n",
                        dev->name);
                return NULL;
        }

        printk("Found device \"%s\", getting sensor data\n", dev->name);
        return dev;
}

static void get_hc_sr04_sensor_val(const struct device *dev){
	int ret;
	struct sensors_data data;
	struct sensor_value distance;

	sensor_sample_fetch(dev);
	sensor_channel_get(dev, SENSOR_CHAN_DISTANCE, &distance);

	printk("Distance: %d.%03dM\n", distance.val1, (distance.val2 / 1000));
	data.distance1 = distance.val1;
	data.distance2 = distance.val2;

}

int main(void)
{
	int ret;
	const struct device *dev_hc_sr04 = get_hc_sr04_device();

	if (dev_hc_sr04 == NULL){
		printk("Failed to get device: hc_sr04\n");
		return 1;
	}

	while(1){
		get_hc_sr04_sensor_val(dev_hc_sr04);
		k_sleep(K_MSEC(1000));
	}

	return 0;
}
```
